## conf/distro/poky-jukebox.conf
```bitbake
require conf/distro/poky.conf

DISTRO = "poky-jukebox"
DISTROOVERRIDES = "poky:poky-jukebox"

require conf/distro/include/poky-distro-alt-test-config.inc

INIT_MANAGER = "systemd"
DISTRO_FEATURES:append = " systemd"
VIRTUAL-RUNTIME_init_manager = "systemd"
				
DISTRO_FEATURES_BACKFILL_CONSIDERED = "sysvinit"
VIRTUAL-RUNTIME_initscripts = ""

PACKAGE_CLASSES = "package_ipk"

# i686 or x86_64
SDKMACHINE = "x86_64"

GLIBC_GENERATE_LOCALES = "de_DE.UTF-8"
IMAGE_LINGUAS = "de-de"

LICENSE_FLAGS_WHITELIST = "commercial"


RPI_KERNEL_DEVICETREE_OVERLAYS = "overlays/wm8960-soundcard.dtbo "	 
WM8960_AUDIO_HAT="1"

#for rfid
ENABLE_SPI_BUS="1"

IMAGE_FSTYPES += "wic"

KERNEL_IMAGETYPE = "Image"

PREFERRED_VERSION_linux-raspberrypi = "5.10.%"
```
